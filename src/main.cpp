////////////////////////////////////////////////////////////////////////////////////////
//      |LIBRERIAS|
////////////////////////////////////////////////////////////////////////////////////////

#include <Arduino.h>
#include <Adafruit_GFX.h>    // Core graphics library
#include <Adafruit_ST7735.h> // Hardware-specific library for ST7735
#include <SPI.h>
#include <Buzzer.h>
#include <RotaryEncoder.h>
#include <Adafruit_ADS1X15.h>

////////////////////////////////////////////////////////////////////////////////////////
//      |COLORES|
////////////////////////////////////////////////////////////////////////////////////////

#define ST7735_BLACK 0x0000
#define ST7735_LIGHT_GRAY 0xBDF7
#define ST7735_DARK_GRAY 0x7BEF
#define ST7735_ORANGE 0xFBE0
#define ST7735_BROWN 0x79E0
#define ST7735_PINK 0xF81F
#define ST7735_BLUE 0x001F
#define ST7735_RED 0xF800
#define ST7735_GREEN 0x07E0
#define ST7735_CYAN 0x07FF
#define ST7735_MAGENTA 0xF81F
#define ST7735_YELLOW 0xFFE0
#define ST7735_WHITE 0xFFFF

////////////////////////////////////////////////////////////////////////////////////////
//      |BITMAPS|
////////////////////////////////////////////////////////////////////////////////////////

const unsigned char cooler_icon [] PROGMEM = {

  0x08, 0xc0,
  0x19, 0xf0,
  0x39, 0xc0,
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  0x03, 0x80

};

const unsigned char logo_icon [] PROGMEM = {

  0x00, 0x00, 0x00, 0x00, 0x00, 0x00, 0x00, 0x00, 0x00, 0x00, 0x00, 0x00, 0x00,
  0x00, 0x00, 0x00, 0x00, 0x00, 0x00, 0x00, 0x00, 0x00, 0x00, 0x00, 0x00, 0x00,
  0x00, 0x00, 0x00, 0x00, 0x00, 0x00, 0x00, 0x00, 0x00, 0x00, 0x00, 0x00, 0x00,
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  0x00, 0x00, 0x00, 0x00, 0x00, 0x00, 0x00, 0x00, 0x00, 0x00, 0x00, 0x00, 0x00

};

const unsigned char temp_icon [] PROGMEM = {

  0x18,
  0x24,
  0x2c,
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  0x42,
  0x3c

};

////////////////////////////////////////////////////////////////////////////////////////
//      |PINES|
////////////////////////////////////////////////////////////////////////////////////////

#define CLK1           2    // DT2
#define DT1            3    // pulsador en pin 3 pagina--
#define SW             4    // buzzer pasivo en pin 4
#define Out            5    // salida PWM
#define Vent           6    // pwm ventilador
#define BUZZ           7    // pin buzzer pasivo
#define TFT_DC         9    // pin tft
#define TFT_RST        8    // pin tft
#define TFT_CS         10   // pin tft
#define OnOff          12   // Constant Current || Constant Voltage

#define MulCap         A0   // conexion amasa de multiplicador de capacitancia
#define lm35pin        A1   // sensor lm35 temp

////////////////////////////////////////////////////////////////////////////////////////
//      |VARIABLES GLOBALES|
////////////////////////////////////////////////////////////////////////////////////////

float V5 = 5.02; //voltaje entre 5v y gnd con cable violeta de la fuente aliemntando el arduino

float R1 = 119200.0;
float R2 = 14860.0;
float vout;
float vin;

int Counter = 0, LastCount = 0;

int pagina = 0;

Adafruit_ST7735 tft = Adafruit_ST7735(TFT_CS, TFT_DC, TFT_RST);
Adafruit_ADS1115 ads;
RotaryEncoder Rotary(&RotaryChanged, DT1, CLK1, SW); // Pins 2 (DT), 3 (CLK), 4 (SW)
Buzzer buzzer(BUZZ);

int ANTERIOR = 0;    // almacena valor anterior de la variable POSICION
float POSICION = 0; // variable POSICION con valor inicial de 50 y definida

bool primerMuestreo = false;

float Idc = 0;

unsigned long lastButtonPress = 0;
float duty = 0;

float tempPorc;
float temperature;

int vDec;
int iDec;
int pDec;

const int numSamples = 10;  // Número de muestras a promediar
int16_t samples[numSamples];
int sampleIndex = 0;
float sum = 0.0; 

////////////////////////////////////////////////////////////////////////////////////////
//      |FUNCIONES GENERALES|
////////////////////////////////////////////////////////////////////////////////////////

void setup() {

  Serial.begin(9600);

  tft.initR(INITR_BLACKTAB);

  tft.setFont();
  tft.setRotation(3);
  tft.setTextWrap(false);

  tft.fillScreen(ST7735_BLACK);
  tft.drawBitmap(30, 14, logo_icon, 100, 100, ST7735_WHITE);

  ads.begin();

  /*
    buzzer.begin(100);
    buzzer.sound(NOTE_D7, 180);
    buzzer.sound(NOTE_A6, 180);
    buzzer.sound(NOTE_C7, 170);
    buzzer.sound(NOTE_B6, 150);
    buzzer.sound(NOTE_E7, 130);
    buzzer.end(100);
  */

  delay(2000);
  tft.fillScreen(ST7735_BLACK);

  pinMode(lm35pin, INPUT);
  pinMode(MulCap, OUTPUT);
  pinMode(OnOff, INPUT_PULLUP);
  pinMode(Vent, OUTPUT);
  pinMode(Out, OUTPUT);
  pinMode(BUZZ, OUTPUT);
  
  digitalWrite(Out, HIGH);
  digitalWrite(MulCap, LOW);
  digitalWrite(Vent, LOW);

  Rotary.setup();

  //melodiaInicio();

}

void loop() {

  Serial.println(duty);

  tft.setFont();
  tft.setRotation(3);
  tft.setTextWrap(false);

  if (LastCount != POSICION) {
    LastCount = POSICION;
  }

  rotulo();
  bitmaps();
  temperatura();
  pulsadores();

  switch (pagina) {
    case 0:
      if (digitalRead(OnOff) == HIGH) {
        digitalWrite(Out, HIGH);
      }
      else {
        digitalWrite(Out, LOW);
      }
      voltajeColor();
      corrienteColor();
      potenciaColor();
      tft.drawLine(0, 33, 160, 33, ST7735_CYAN);
      voltajeCuenta();
      corrienteCuenta();
      break;

    case 1:
      voltajeCuenta();
      corrienteCuenta();
      PWM();
      break;
  }
}

////////////////////////////////////////////////////////////////////////////////////////
//      |FUNCIONES PERSONALIZADAS|
////////////////////////////////////////////////////////////////////////////////////////

void RotaryChanged() {
  const unsigned int state = Rotary.GetState();

  if (state & DIR_CW && pagina == 1)  {
    POSICION++;
  }
  if (state & DIR_CCW && pagina == 1) {
    POSICION--;
  }

  POSICION = min(100, max(0, POSICION));
}

void pulsadores() {
  int btnState = digitalRead(SW);
  if (Rotary.GetButtonDown()) {
    if (millis() - lastButtonPress > 50) {
      tft.fillScreen(ST7735_BLACK);
      buzzer.sound(NOTE_E7, 100);
      primerMuestreo = true;

      if (pagina >= 1) {
        pagina = 0;
      }
      else {
        pagina++;
      }
    }
    lastButtonPress = millis();
  }
}

void temperatura() {
  
  float temp = analogRead(lm35pin);
  temperature = (V5 * temp * 100.0) / 1024;

  float tempCurve = temperature * 3.375;
  tempPorc = 3.333 * (temperature - 45);

  if (tempPorc >= 100) tempPorc = 100;
  else if (tempPorc <= 0) tempPorc = 0;

  if (tempCurve >= 255) tempCurve = 255;


  ////////////////////////////////////////////////////////////////////////////////////////

  if (temperature >= 45) analogWrite(Vent, 255);
  else analogWrite(Vent, 0);

  if ((int)temperature >= 75) tft.setTextColor(ST7735_RED, ST7735_BLACK);
  else tft.setTextColor(ST7735_WHITE, ST7735_BLACK);

  ////////////////////////////////////////////////////////////////////////////////////////

  tft.setCursor(4, 118);
  tft.print((int)temperature);

  if ((int)temperature > 99) tft.println("C");
  else if (((int)temperature > 9)) tft.println(" C");
  else tft.println("  C");

  ////////////////////////////////////////////////////////////////////////////////////////

  tft.setTextColor(ST7735_WHITE, ST7735_BLACK);
  tft.setCursor(134, 118);
  tft.print((int)tempPorc);

  if ((int)tempPorc > 99) tft.println("%");
  else if ((int)tempPorc > 9) tft.println(" %");
  else tft.println("  %");

}

void bitmaps() {

  if (tempPorc >= 1) tft.drawBitmap(138, 101, cooler_icon, 15, 15, ST7735_GREEN);
  else tft.drawBitmap(138, 101, cooler_icon, 15, 15, ST7735_RED);

  if (temperature < 45)tft.drawBitmap(11, 101, temp_icon, 8, 15, ST7735_GREEN);
  else if (temperature >= 45 && temperature < 60)tft.drawBitmap(11, 101, temp_icon, 8, 15, ST7735_YELLOW);
  else if (temperature >= 60 && temperature < 75)tft.drawBitmap(11, 101, temp_icon, 8, 15, ST7735_ORANGE);
  else if (temperature >= 75)tft.drawBitmap(11, 101, temp_icon, 8, 15, ST7735_RED);

}

void rotulo() {

  tft.drawLine(0, 0, 160, 0, ST7735_CYAN);
  tft.drawLine(0, 0, 0, 128, ST7735_CYAN);
  tft.drawLine(0, 127, 160, 127, ST7735_CYAN);
  tft.drawLine(159, 0, 159, 128, ST7735_CYAN);

  tft.drawLine(0, 99, 160, 99, ST7735_CYAN);
  tft.drawLine(30, 113, 131, 113, ST7735_CYAN);

  tft.drawLine(131, 99, 131, 127, ST7735_CYAN);
  tft.drawLine(29, 99, 29, 127, ST7735_CYAN);
  tft.drawLine(81, 99, 81, 113, ST7735_CYAN);

  tft.drawLine(0, 66, 160, 66, ST7735_CYAN);

  ////////////////////////////////////////////////////////////////////

  unsigned long runMillis = millis();
  unsigned long allSeconds = millis() / 1000;
  int runHours = allSeconds / 3600;
  int secsRemaining = allSeconds % 3600;
  int runMinutes = secsRemaining / 60;
  int runSeconds = secsRemaining % 60;

  char buf[21];
  sprintf(buf, "%02d:%02d:%02d", runHours, runMinutes, runSeconds);

  tft.setTextSize(1);
  tft.setTextColor(ST7735_WHITE, ST7735_BLACK);

  tft.setCursor(32, 103);  // posicion (x,y)
  tft.println(buf);

  ////////////////////////////////////////////////////////////////////
  /*
    if(digitalRead(CcCv) == LOW){
      tft.setCursor(86, 103);
      tft.setTextColor(ST7735_GREEN);
      tft.print("CV");
      tft.setTextColor(ST7735_WHITE);
      tft.print(" | ");
      tft.setTextColor(ST7735_RED);
      tft.print("CC");
    }

    if(digitalRead(CcCv) == HIGH){
      tft.setCursor(86, 103);
      tft.setTextColor(ST7735_RED);
      tft.print("CV");
      tft.setTextColor(ST7735_WHITE);
      tft.print(" | ");
      tft.setTextColor(ST7735_GREEN);
      tft.print("CC");
    }
  */

  ////////////////////////////////////////////////////////////////////

  tft.setTextColor(ST7735_WHITE);
  tft.setCursor(54, 117);  // posicion (x,y)
  tft.println("DIPS30V5A");
}

void voltajeColor() {

  tft.setTextSize(3);
  tft.setTextColor(ST7735_GREEN, ST7735_BLACK);
  tft.setCursor(9, 6);
  tft.print("V:");
  tft.println(vin, vDec);

}

void corrienteColor() {

  tft.setTextColor(ST7735_YELLOW, ST7735_BLACK);
  tft.setCursor(9, 39);
  tft.setTextSize(3);
  tft.print("I:");

  tft.println(Idc, iDec);
}

void potenciaColor() {

  float potencia = Idc * vin;

  if (potencia <= 0) potencia = 0;
  if (potencia <= 9.999) pDec = 4;
  if (potencia > 9.999 && potencia <= 99.999) pDec = 3;
  if (potencia > 99.999 && potencia <= 999.999) pDec = 2;

  tft.setTextColor(ST7735_MAGENTA, ST7735_BLACK);
  tft.setCursor(9, 72);
  tft.setTextSize(3);
  tft.print("W:");
  tft.println(potencia, pDec);
}

void voltajeCuenta() {

  ads.setGain(GAIN_ONE);
  float multiplier1 = 0.000125F;

  float results1 = ads.readADC_SingleEnded(0);
  vout = results1 * multiplier1;
  vin = vout / 0.1108458;

  if (vin <= 0) vin = 0;
  if (vin <= 9.999) vDec = 4;
  else vDec = 3;

}

void corrienteCuenta() {

  ads.setGain(GAIN_SIXTEEN);
  
  int16_t adc0 = ads.readADC_SingleEnded(1);  
  sum = sum - samples[sampleIndex] + adc0;
  samples[sampleIndex] = adc0;
  sampleIndex = (sampleIndex + 1) % numSamples;  // Circular el índice

  // Calcular el promedio de las muestras
  float averagedValue = sum / numSamples;
  
  float multiplier = 0.0000078125F;
  float voltage = averagedValue * multiplier;
  Idc = voltage / 0.0137;

  if (Idc <= 0) Idc = 0;
  if (Idc <= 9.999) iDec = 4;
  else iDec = 3;

}

void PWM() {

  int warnColor;
  if (digitalRead(OnOff) == HIGH) {
    digitalWrite(Out, HIGH);
  }
  else {
    analogWrite(Out, (int) duty);
  }
  duty = 2.55 * POSICION;
  float potencia = Idc * vin;

  if (potencia <= 0) potencia = 0;
  if (potencia <= 9.999) pDec = 4;
  if (potencia > 9.999 && potencia <= 99.999) pDec = 3;
  if (potencia > 99.999 && potencia <= 999.999) pDec = 2;

  /////////////////////////////////////////////////////////////////////////////////

  tft.drawLine(81, 66, 81, 99, ST7735_CYAN);
  tft.drawLine(0, 82, 160, 82, ST7735_CYAN);

  tft.setTextColor(ST7735_GREEN, ST7735_BLACK);
  tft.setCursor(16, 71);
  tft.setTextSize(1);
  tft.print("V:");
  tft.println(vin, vDec);

  tft.setTextColor(ST7735_YELLOW, ST7735_BLACK);
  tft.setCursor(16, 87);
  tft.setTextSize(1);
  tft.print("I:");
  tft.println(Idc, iDec);

  tft.setTextColor(ST7735_MAGENTA, ST7735_BLACK);
  tft.setCursor(96, 71);
  tft.setTextSize(1);
  tft.print("W:");
  tft.println(potencia, pDec);

  tft.setTextColor(ST7735_BLUE, ST7735_BLACK);
  tft.setCursor(103, 87);
  tft.setTextSize(1);
  tft.print("D:");
  tft.print((int)POSICION);
  tft.println("%  ");

  /////////////////////////////////////////////////////////////////////////////////

  if (LastCount != POSICION || primerMuestreo == true) {

    tft.fillRect(10, 10, 140, 46, ST7735_BLACK);

    if (POSICION == 0) tft.drawLine(11, 55, 149, 55, ST7735_ORANGE);
    else if (POSICION == 100) tft.drawLine(11, 11, 149, 11, ST7735_ORANGE);
    else {
      int dLine =  11 + (1.38 * POSICION);

      tft.drawLine(11, 11, 11, 55, ST7735_ORANGE);

      tft.drawLine(11, 11, dLine, 11, ST7735_ORANGE);
      tft.drawLine(dLine, 11, dLine, 55, ST7735_ORANGE);
      tft.drawLine(dLine, 55, 149, 55, ST7735_ORANGE);

    }

    primerMuestreo = false;

  }
}

void melodiaInicio() {
  buzzer.begin(100);
  buzzer.sound(NOTE_E7, 60);
  buzzer.sound(NOTE_C7, 60);
  buzzer.sound(NOTE_G7, 100);
  buzzer.end(100);
}